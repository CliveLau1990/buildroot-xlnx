## configs/motion_defconfig
```kconfig
# Target options
BR2_arm=y
BR2_cortex_a9=y
BR2_ARM_ENABLE_NEON=y
# Linux headers same as kernel, a 3.18 series
BR2_PACKAGE_HOST_LINUX_HEADERS_CUSTOM_3_18=y
# Toolchain
BR2_TOOLCHAIN_EXTERNAL=y
BR2_TOOLCHAIN_EXTERNAL_CUSTOM=y
BR2_TOOLCHAIN_EXTERNAL_PREINSTALLED=y
BR2_TOOLCHAIN_EXTERNAL_PATH="/opt/Xilinx/SDK/2015.2/gnu/arm/lin"
BR2_TOOLCHAIN_EXTERNAL_CUSTOM_PREFIX="$(ARCH)-xilinx-linux-gnueabi"
BR2_TOOLCHAIN_EXTERNAL_PREFIX="$(ARCH)-xilinx-linux-gnueabi"
BR2_TOOLCHAIN_EXTERNAL_GLIBC=y
BR2_TOOLCHAIN_EXTERNAL_GCC_4_9=y
BR2_TOOLCHAIN_EXTERNAL_HEADERS_3_16=y
BR2_TOOLCHAIN_EXTERNAL_CUSTOM_GLIBC=y
BR2_TOOLCHAIN_EXTERNAL_INET_RPC=y
BR2_TOOLCHAIN_EXTERNAL_CXX=y
# System configuration
BR2_TARGET_GENERIC_HOSTNAME="Motion"
BR2_TARGET_GENERIC_ISSUE="Welcome to Motion project"
BR2_TARGET_GENERIC_GETTY_PORT="ttyPS1"
# Filesystem images
BR2_TARGET_ROOTFS_CPIO=y
BR2_TARGET_ROOTFS_CPIO_GZIP=y
BR2_TARGET_ROOTFS_CPIO_UIMAGE=y
```
